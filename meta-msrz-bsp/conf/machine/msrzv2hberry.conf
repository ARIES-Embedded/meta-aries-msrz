## meta-msrz-bsp/conf/machine/msrzv2hberry.conf
```bitbake
#@TYPE: Machine
#@NAME: msrzv2hberry
#@DESCRIPTION: RZ/V2H module MSRZV2H on baseboard V2Hberry

require conf/machine/include/rzv2h-family.inc
require conf/machine/include/arm/armv8-2a/tune-cortexa55.inc
require conf/machine/include/rz-common.inc

SERIAL_CONSOLES ?= "115200;ttySC0"
PREFERRED_VERSION_trusted-firmware-a ?= "2.10%"
TFA_PLATFORM ?= "v2h"
TFA_BOARD ?= "msrz"
TFA_UBOOT ?= "1"
TFA_BUILD_TARGET ?= "bl2 fip"
BL2_BOOT_TARGET ?= "spi mmc esd"
EXTRA_IMAGEDEPENDS += " firmware-pack"

BL2_BASE_ADDR ?= "0x08103000"
BL2_ADJUST_VMA ?= "0x08101E00"
FIP_ADJUST_VMA ?= "0x0"

# U-Boot Configuration
PREFERRED_VERSION_u-boot ?= "v2024.07%"
UBOOT_CONFIG ??= "msrzv2hberry"
UBOOT_CONFIG[msrzv2hberry] = "msrzv2hberry_defconfig"

# flash writer
EXTRA_IMAGEDEPENDS += " flash-writer"

# firmware pack
EXTRA_IMAGEDEPENDS += " firmware-pack"

# Supported devicetree
KERNEL_DEVICETREE = " \
	renesas/msrzv2hberry.dtb \
	renesas/msrzv2hberry-display-dp.dtb \
	renesas/msrzv2hberry-display-panel.dtb \
"

IMAGE_BOOT_FILES = " \
	bl2_bp_spi-${MACHINE}.bin \
	bl2_bp_spi-${MACHINE}.srec \
	bl2_bp_mmc-${MACHINE}.bin \
	bl2_bp_mmc-${MACHINE}.srec \
	fip-${MACHINE}.bin \
	fip-${MACHINE}.srec \
	Flash_Writer_SCIF_RZV2H_DEV_INTERNAL_MEMORY.mot \
"

# Wic image
WKS_FILE = "rz-image-bootpart-esd.wks"
do_image_wic[depends] += "firmware-pack:do_deploy"
```
