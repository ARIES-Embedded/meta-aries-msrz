## Kconfig
```kconfig
mainmenu "ARIES embedded MSRZ Configuration"

config KAS_BUILD_SYSTEM
	string
	default "openembedded"

config KAS_INCLUDE_BASE
	string
	default "kas/base.yml"

config FAMILY_G3E
bool

menu "Machines"
choice
	prompt "Select machine:"
	default MACHINE_MSRZG3EEVK

	config MACHINE_MSRZGEEVK
	bool "msrzgeevk"
	select FAMILY_G3E
	help
		Select the Renesas RZ/G3E reference platform.

	config KAS_INCLUDE_MACHINE_MSRZGEEVK
	string
	depends on MACHINE_MSRZGEEVK
	default "kas/machines/msrzgeevk.yml"

endchoice
endmenu

menu "Targets"
choice
	prompt "Select target:"
	default IMAGE_CORE_IMAGE_MINIMAL

	config IMAGE_CORE_IMAGE_MINIMAL
	bool "core-image-minimal"
	help
		A small image just capable of allowing a device to boot.

	config KAS_INCLUDE_IMAGE_CORE_IMAGE_MINIMAL
	string
	depends on IMAGE_CORE_IMAGE_MINIMAL
	default "kas/images/core-image-minimal.yml"

	config IMAGE_CORE_IMAGE_WESTON
	bool "core-image-weston"
	help
		A very basic Wayland image with a terminal.
		This image provides the Wayland protocol libraries and the reference Weston compositor.
		It also contains GStreamer 1.0 framework, tools, and multimedia support packages.

	config KAS_INCLUDE_IMAGE_CORE_IMAGE_WESTON
	string
	depends on IMAGE_CORE_IMAGE_WESTON
	default "kas/images/core-image-weston.yml"

endchoice
endmenu

menu "Features"
	config FEATURE_GRAPHICS
	bool "Graphics"
	default n
	help
		Enable support for the GPU using meta-rz-graphics.
		Note that the meta-rz-features/meta-rz-graphics directory should be extracted to the working directory.

	config KAS_INCLUDE_FEATURE_GRAPHICS
	string
	depends on FEATURE_GRAPHICS
	default "kas/features/graphics.yml"

	config FEATURE_CODECS
	bool "Codecs"
	default n
	help
		Enable support for the Renesas codec libraries using meta-rz-multimedia.
		Note that the meta-rz-features/meta-rz-codecs directory should be extracted to the working directory.

	config KAS_INCLUDE_FEATURE_CODECS
	string
	depends on FEATURE_CODECS
	default "kas/features/codecs.yml"
endmenu

menu "Misc"
	config KERNEL_REALTIME
	bool "Kernel-realtime"
	default n
	help
		Choose realtime characteristic of Linux kernel to build with.

	config KAS_INCLUDE_KERNEL_REALTIME
	string
	depends on KERNEL_REALTIME
	default "kas/misc/kernel-rt.yml"

	config DOCKER
	bool "Docker"
	depends on !KERNEL_REALTIME
	default n
	help
		Enable the Docker Engine to build with.

	config KAS_INCLUDE_DOCKER
	string
	depends on DOCKER
	default "kas/misc/docker.yml"
endmenu
```

## meta-mrzg2ls/conf/layer.conf
```bitbake
# We have a conf and classes directory, add to BBPATH
BBPATH .= ":${LAYERDIR}"

# We have recipes-* directories, add to BBFILES
BBFILES += "${LAYERDIR}/recipes-*/*/*.bb \
            ${LAYERDIR}/recipes-*/*/*.bbappend"

BBFILE_COLLECTIONS += "mrzg2ls"
BBFILE_PATTERN_mrzg2ls = "^${LAYERDIR}/"
BBFILE_PRIORITY_mrzg2ls = "15"

LAYERDEPENDS_msrzg2sls = "msrz-common"
LAYERSERIES_COMPAT_mrzg2ls= "dunfell"
```

## meta-mrzg2ls/conf/machine/mrzg2ls.conf
```bitbake
#@TYPE: Machine
#@NAME: msrzg2ul machine
#@DESCRIPTION: ARIES SMARC MRZG2LS OSM

SOC_FAMILY = "r9a07g044l"
require conf/machine/include/rzg2l-common.inc
require conf/machine/include/cip-core.inc

DEFAULTTUNE ?= "cortexa55"

TUNE_CONF ?= "conf/machine/include/tune-cortexa55.inc"
require ${TUNE_CONF}

PREFERRED_PROVIDER_virtual/kernel = "linux-renesas"

UBOOT_CONFIG ??= "mrzg2ls"
UBOOT_CONFIG[mrzg2ls] = "mrzg2ls_defconfig"

# flash writer
EXTRA_IMAGEDEPENDS += " flash-writer"

# Supported devicetree
KERNEL_DEVICETREE = "aries/mrzg2ls.dtb aries/mrzg2ls-display-dp.dtb aries/mrzg2ls-display-panel.dtb"
KERNEL_IMAGETYPES = "Image.gz"
IMAGE_BOOT_FILES = " \
	bl2_bp-${MACHINE}.bin \
	fip-${MACHINE}.bin \
	bl2_bp-${MACHINE}.srec \
	fip-${MACHINE}.srec \
	Flash_Writer_SCIF_RZG2L_SMARC_PMIC_DDR4_2GB_1PCS.mot \
"

WIC_INPUT_DEPENDS = "firmware-pack:do_deploy flash-writer:do_deploy"

WKS_FILE = "rz-image-bootpart-mmc.wks"
IMAGE_FSTYPES += "wic.gz"

# Force remake wic image if its inputs were changed (WIC_INPUT_DEPENDS are defined in each machine conf)
# Note that environment variable WKS_FILE_DEPENDS can be used here, but it makes do_rootfs rerun as well
do_image_wic[depends] += "${WIC_INPUT_DEPENDS}"
```

## meta-mrzv2ls/conf/layer.conf
```bitbake
# We have a conf and classes directory, add to BBPATH
BBPATH .= ":${LAYERDIR}"

# We have recipes-* directories, add to BBFILES
BBFILES += "${LAYERDIR}/recipes-*/*/*.bb \
            ${LAYERDIR}/recipes-*/*/*.bbappend"

BBFILE_COLLECTIONS += "mrzv2ls"
BBFILE_PATTERN_mrzv2ls = "^${LAYERDIR}/"
BBFILE_PRIORITY_mrzv2ls = "15"

LAYERDEPENDS_mrzv2ls = "msrz-common"
LAYERSERIES_COMPAT_mrzv2ls= "dunfell"
```

## meta-mrzv2ls/conf/machine/mrzv2ls.conf
```bitbake
#@TYPE: Machine
#@NAME: mrzv2ls machine
#@DESCRIPTION: ARIES SMARC MRZV2LS

SOC_FAMILY = "r9a07g054l"
require conf/machine/include/rzv2l-common.inc
require conf/machine/include/cip-core.inc

DEFAULTTUNE ?= "cortexa55"

TUNE_CONF ?= "conf/machine/include/tune-cortexa55.inc"
require ${TUNE_CONF}

PREFERRED_PROVIDER_virtual/kernel = "linux-renesas"

UBOOT_CONFIG ??= "mrzv2ls"
UBOOT_CONFIG[mrzv2ls] = "mrzv2ls_defconfig"

# flash writer
EXTRA_IMAGEDEPENDS += " flash-writer"

KERNEL_DEVICETREE = "aries/mrzv2ls.dtb aries/mrzv2ls-display-dp.dtb aries/mrzv2ls-display-panel.dtb"
KERNEL_IMAGETYPES = "Image.gz"
IMAGE_INSTALL_append = " kernel-image kernel-devicetree"

WIC_INPUT_DEPENDS = "firmware-pack:do_deploy flash-writer:do_deploy"

WKS_FILE = "msrz-image-bootpart-mmc.wks"
IMAGE_FSTYPES += "wic.gz"

# Force remake wic image if its inputs were changed (WIC_INPUT_DEPENDS are defined in each machine conf)
# Note that environment variable WKS_FILE_DEPENDS can be used here, but it makes do_rootfs rerun as well
do_image_wic[depends] += "${WIC_INPUT_DEPENDS}"
```

## meta-msrz-bsp/conf/layer.conf
```bitbake
# We have a conf and classes directory, add to BBPATH
BBPATH .= ":${LAYERDIR}"

# We have recipes-* directories, add to BBFILES
BBFILES += "${LAYERDIR}/recipes-*/*/*.bb \
            ${LAYERDIR}/recipes-*/*/*.bbappend"

BBFILE_COLLECTIONS += "meta-msrz-bsp"
BBFILE_PATTERN_meta-msrz-bsp = "^${LAYERDIR}/"
BBFILE_PRIORITY_meta-msrz-bsp = "15"

LAYERDEPENDS_meta-msrz-bsp = "core"
LAYERSERIES_COMPAT_meta-msrz-bsp = "scarthgap"
```

## meta-msrz-bsp/conf/machine/msrzg3eevk.conf
```bitbake
#@TYPE: Machine
#@NAME: msrzg3eevk
#@DESCRIPTION: Configuration for the ARIES embedded RZ/G3E OSM MSRZG3E on EVK

require conf/machine/include/arm/armv8-2a/tune-cortexa55.inc
require conf/machine/include/rz-common.inc
require conf/machine/include/rzg3e-family.inc

# Machine configuration
MACHINE_FEATURES:append = " ext2 pci serial usbgadget usbhost can"

# Trusted Firmware-A configuration
PREFERRED_VERSION_trusted-firmware-a ?= "2.10%"
TFA_PLATFORM ?= "g3e"
TFA_BOARD ?= "msrz"
TFA_UBOOT ?= "1"
TFA_BUILD_TARGET ?= "bl2 fip"
BL2_BOOT_TARGET ?= "spi mmc esd"
BL2_ADJUST_VMA ?= "0x08003600"
FIP_ADJUST_VMA ?= "0x0000"
EXTRA_IMAGEDEPENDS += " firmware-pack"

# U-Boot Configuration
UBOOT_CONFIG ??= "msrzg3eevk"
UBOOT_CONFIG[msrzg3eevk] = "msrzg3eevk_defconfig"
PREFERRED_VERSION_u-boot = "2024.07%"

IMAGE_BOOT_FILES = " \
	bl2_bp_spi-${MACHINE}.bin \
	bl2_bp_spi-${MACHINE}.srec \
	bl2_bp_mmc-${MACHINE}.bin \
	bl2_bp_mmc-${MACHINE}.srec \
	fip-${MACHINE}.bin \
	fip-${MACHINE}.srec \
	Flash_Writer_SCIF_MSRZG3EEVK_LPDDR4.mot \
"

# Supported devicetree
KERNEL_DEVICETREE = " \
	aries/msrzg3eevk-sd.dtb \
	aries/msrzg3eevk-emmc.dtb \
"

# Wic image
WKS_FILE = "rz-image-bootpart-esd-g3e.wks"
do_image_wic[depends] += "firmware-pack:do_deploy"
```

## meta-msrz-common/conf/layer.conf
```bitbake
# We have a conf and classes directory, add to BBPATH
BBPATH .= ":${LAYERDIR}"

# We have recipes-* directories, add to BBFILES
BBFILES += "${LAYERDIR}/recipes-*/*/*.bb \
            ${LAYERDIR}/recipes-*/*/*.bbappend"

BBFILE_COLLECTIONS += "msrz-common"
BBFILE_PATTERN_msrz-common = "^${LAYERDIR}/"
BBFILE_PRIORITY_msrz-common = "15"

LAYERDEPENDS_msrz-common = "rz-common"
LAYERSERIES_COMPAT_msrz-common = "dunfell"
```

## meta-msrz-common/wic/msrz-image-bootpart-mmc.wks
```
# Short-description: Create image for SD-Card or eMMC
# Long-description: Creates a image that can be used to write to SD-Card or eMMC for RZ boards
#                   The partition contains rootfs, as well as Linux image and devicetree
part --source rootfs            --fstype=ext4 --label root            --align 4
```

## meta-msrzfive/conf/layer.conf
```bitbake
# We have a conf and classes directory, add to BBPATH
BBPATH .= ":${LAYERDIR}"

# We have recipes-* directories, add to BBFILES
BBFILES += "${LAYERDIR}/recipes-*/*/*.bb \
            ${LAYERDIR}/recipes-*/*/*.bbappend"

BBFILE_COLLECTIONS += "msrzfive"
BBFILE_PATTERN_msrzfive = "^${LAYERDIR}/"
BBFILE_PRIORITY_msrzfive = "15"

LAYERDEPENDS_msrzfive = "msrz-common"
LAYERSERIES_COMPAT_msrzfive = "dunfell"
```

## meta-msrzfive/conf/machine/msrzfive.conf
```bitbake
#@TYPE: Machine
#@NAME: msrzfive machine
#@DESCRIPTION: ARIES MSRZFIVE OSM

SOC_FAMILY = "r9a07g043f"
require conf/machine/include/rzfive-common.inc
require conf/machine/include/cip-core.inc
require conf/machine/include/riscv/tune-rz-rv64.inc

PREFERRED_PROVIDER_virtual/kernel="linux-renesas"

UBOOT_CONFIG ??= "msrzfive"
UBOOT_CONFIG[msrzfive] = "msrzfive_defconfig"

# flash writer
EXTRA_IMAGEDEPENDS += " flash-writer"

# Supported devicetree
KERNEL_DEVICETREE = "aries/msrzfive.dtb aries/msrzfive-no-emmc.dtb"
KERNEL_IMAGETYPES = "Image.gz"
```

## meta-msrzg2ls/conf/layer.conf
```bitbake
# We have a conf and classes directory, add to BBPATH
BBPATH .= ":${LAYERDIR}"

# We have recipes-* directories, add to BBFILES
BBFILES += "${LAYERDIR}/recipes-*/*/*.bb \
            ${LAYERDIR}/recipes-*/*/*.bbappend"

BBFILE_COLLECTIONS += "msrzg2ls"
BBFILE_PATTERN_msrzg2ls = "^${LAYERDIR}/"
BBFILE_PRIORITY_msrzg2ls = "15"

LAYERDEPENDS_msrzg2sls = "msrz-common"
LAYERSERIES_COMPAT_msrzg2ls= "dunfell"
```

## meta-msrzg2ls/conf/machine/msrzg2ls.conf
```bitbake
#@TYPE: Machine
#@NAME: msrzg2ul machine
#@DESCRIPTION: ARIES SMARC MSRZG2L OSM

SOC_FAMILY = "r9a07g044l"
require conf/machine/include/rzg2l-common.inc
require conf/machine/include/cip-core.inc

DEFAULTTUNE ?= "cortexa55"

TUNE_CONF ?= "conf/machine/include/tune-cortexa55.inc"
require ${TUNE_CONF}

PREFERRED_PROVIDER_virtual/kernel = "linux-renesas"

UBOOT_CONFIG ??= "msrzg2ls"
UBOOT_CONFIG[msrzg2ls] = "msrzg2ls_defconfig"

# flash writer
EXTRA_IMAGEDEPENDS += " flash-writer"

# Supported devicetree
KERNEL_DEVICETREE = "aries/msrzg2ls.dtb"
KERNEL_IMAGETYPES = "Image.gz"

# FIXME: remove when the board-specific configuration is ready.
UBOOT_CONFIG[msrzg2ls] = "smarc-rzg2l_defconfig"
KERNEL_DEVICETREE = " \
	renesas/r9a07g044l2-dev.dtb \
"
```

## meta-msrzg2ul/conf/layer.conf
```bitbake
# We have a conf and classes directory, add to BBPATH
BBPATH .= ":${LAYERDIR}"

# We have recipes-* directories, add to BBFILES
BBFILES += "${LAYERDIR}/recipes-*/*/*.bb \
            ${LAYERDIR}/recipes-*/*/*.bbappend"

BBFILE_COLLECTIONS += "msrzg2ul"
BBFILE_PATTERN_msrzg2ul = "^${LAYERDIR}/"
BBFILE_PRIORITY_msrzg2ul = "15"

LAYERDEPENDS_msrzg2ul = "msrz-common"
LAYERSERIES_COMPAT_msrzg2ul = "dunfell"
```

## meta-msrzg2ul/conf/machine/msrzg2ul-a0a.conf
```bitbake
#@TYPE: Machine
#@NAME: msrzg2ul-a0a machine
#@DESCRIPTION: ARIES MSRZG2UL-A0A OSM on OSMEVK or G2ULberry

SOC_FAMILY = "r9a07g043u"
require conf/machine/include/rzg2l-common.inc
require conf/machine/include/cip-core.inc

DEFAULTTUNE ?= "cortexa55"

TUNE_CONF ?= "conf/machine/include/tune-cortexa55.inc"
require ${TUNE_CONF}

MACHINEOVERRIDES_append =. ":msrzg2ul"

PREFERRED_PROVIDER_virtual/kernel = "linux-renesas"

UBOOT_CONFIG ??= "msrzg2ul-a0a"
UBOOT_CONFIG[msrzg2ul-a0a] = "msrzg2ul-a0a_defconfig"

# flash writer
EXTRA_IMAGEDEPENDS += " flash-writer"

# Supported devicetree
KERNEL_DEVICETREE = "aries/msrzg2ul-a0a.dtb"
KERNEL_IMAGETYPES = "Image.gz"
IMAGE_INSTALL_append = " kernel-image kernel-devicetree"

WIC_INPUT_DEPENDS = "firmware-pack:do_deploy flash-writer:do_deploy"

WKS_FILE = "msrz-image-bootpart-mmc.wks"
IMAGE_FSTYPES += "wic.gz"

# Force remake wic image if its inputs were changed (WIC_INPUT_DEPENDS are defined in each machine conf)
# Note that environment variable WKS_FILE_DEPENDS can be used here, but it makes do_rootfs rerun as well
do_image_wic[depends] += "${WIC_INPUT_DEPENDS}"
```

## meta-msrzg2ul/conf/machine/msrzg2ul-baa.conf
```bitbake
#@TYPE: Machine
#@NAME: msrzg2ul-baa machine
#@DESCRIPTION: ARIES MSRZG2UL-BAA OSM on OSMEVK or G2ULBerry

SOC_FAMILY = "r9a07g043u"
require conf/machine/include/rzg2l-common.inc
require conf/machine/include/cip-core.inc

DEFAULTTUNE ?= "cortexa55"

TUNE_CONF ?= "conf/machine/include/tune-cortexa55.inc"
require ${TUNE_CONF}

MACHINEOVERRIDES_append =. ":msrzg2ul"

PREFERRED_PROVIDER_virtual/kernel = "linux-renesas"

UBOOT_CONFIG ??= "msrzg2ul-baa"
UBOOT_CONFIG[msrzg2ul-baa] = "msrzg2ul-baa_defconfig"

# flash writer
EXTRA_IMAGEDEPENDS += " flash-writer"

# Supported devicetree
KERNEL_DEVICETREE = "aries/msrzg2ul-baa.dtb"
KERNEL_IMAGETYPES = "Image.gz"
IMAGE_INSTALL_append = " kernel-image kernel-devicetree"

WIC_INPUT_DEPENDS = "firmware-pack:do_deploy flash-writer:do_deploy"

WKS_FILE = "msrz-image-bootpart-mmc.wks"
IMAGE_FSTYPES += "wic.gz"

# Force remake wic image if its inputs were changed (WIC_INPUT_DEPENDS are defined in each machine conf)
# Note that environment variable WKS_FILE_DEPENDS can be used here, but it makes do_rootfs rerun as well
do_image_wic[depends] += "${WIC_INPUT_DEPENDS}"
```

## meta-msrzg2ul/conf/machine/msrzg2ul.conf
```bitbake
#@TYPE: Machine
#@NAME: msrzg2ul machine
#@DESCRIPTION: ARIES MSRZG2UL OSM

SOC_FAMILY = "r9a07g043u"
require conf/machine/include/rzg2l-common.inc
require conf/machine/include/cip-core.inc

DEFAULTTUNE ?= "cortexa55"

TUNE_CONF ?= "conf/machine/include/tune-cortexa55.inc"
require ${TUNE_CONF}

PREFERRED_PROVIDER_virtual/kernel = "linux-renesas"
PREFERRED_PROVIDER_ = "linux-renesas"

UBOOT_CONFIG ??= "msrzg2ul"
UBOOT_CONFIG[msrzg2ul] = "msrzg2ul_defconfig"

# Supported devicetree
KERNEL_DEVICETREE = "aries/msrzg2ul.dtb"
KERNEL_IMAGETYPES = "Image.gz"
```

## meta-msrzg3s/conf/layer.conf
```bitbake
# We have a conf and classes directory, add to BBPATH
BBPATH .= ":${LAYERDIR}"

# We have recipes-* directories, add to BBFILES
BBFILES += "${LAYERDIR}/recipes-*/*/*.bb \
            ${LAYERDIR}/recipes-*/*/*.bbappend"

BBFILE_COLLECTIONS += "msrzg3s"
BBFILE_PATTERN_msrzg3s = "^${LAYERDIR}/"
BBFILE_PRIORITY_msrzg3s = "15"

LAYERDEPENDS_msrzg3s = "rz-common"
LAYERSERIES_COMPAT_msrzg3s = "dunfell"
```

## meta-msrzg3s/conf/machine/msrzg3s-a0a.conf
```bitbake
#@TYPE: Machine
#@NAME: msrzg3s-a0a machine
#@DESCRIPTION: ARIES MSRZG3S-A0A OSM on OSMEVK or G3Sberry

SOC_FAMILY = "r9a08g045"
require conf/machine/include/${SOC_FAMILY}.inc
require conf/machine/include/cip-core.inc

DEFAULTTUNE ?= "cortexa55"

TUNE_CONF ?= "conf/machine/include/tune-cortexa55.inc"
require ${TUNE_CONF}

MACHINEOVERRIDES_append =. ":msrzg3s"

PREFERRED_PROVIDER_virtual/kernel="linux-renesas"

UBOOT_CONFIG ??= "msrzg3s-a0a"
UBOOT_CONFIG[msrzg3s-a0a] = "msrzg3s-a0a_defconfig"

# Add flash writer and firmware-pack
EXTRA_IMAGEDEPENDS += " flash-writer firmware-pack"

# Supported devicetree
KERNEL_DEVICETREE = "aries/msrzg3s-a0a.dtb"

KERNEL_IMAGETYPES = "Image.gz"
IMAGE_INSTALL_append = " kernel-image kernel-devicetree"

WIC_INPUT_DEPENDS = "firmware-pack:do_deploy flash-writer:do_deploy"

WKS_FILE = "msrz-image-bootpart-mmc.wks"
IMAGE_FSTYPES += "wic.gz"

# Force remake wic image if its inputs were changed (WIC_INPUT_DEPENDS are defined in each machine conf)
# Note that environment variable WKS_FILE_DEPENDS can be used here, but it makes do_rootfs rerun as well
do_image_wic[depends] += "${WIC_INPUT_DEPENDS}"
```
